## meta-shadowvault/conf/layer.conf
```bitbake
BBPATH .= ":${LAYERDIR}"

BBFILES += "${LAYERDIR}/recipes-*/*/*.bb \
            ${LAYERDIR}/recipes-*/*/*.bbappend"

BBFILE_COLLECTIONS += "shadowvault"
BBFILE_PATTERN_shadowvault = "^${LAYERDIR}/"
BBFILE_PRIORITY_shadowvault = "6"

LAYERDEPENDS_shadowvault = "core openembedded-layer"
LAYERSERIES_COMPAT_shadowvault = "scarthgap wrynose"
```
